## config/west.yml
```yaml
manifest:
  remotes:
    - name: zmk
      url-base: https://github.com/zmkfirmware
    - name: zephyr
      url-base: https://github.com/zephyrproject-rtos
  projects:
    - name: zmk
      remote: zmk
      revision: main
      import: app/west.yml
    - name: zephyr
      remote: zephyr
      revision: v3.7.0
  self:
    path: config
```
